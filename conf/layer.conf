## conf/layer.conf
```bitbake
# Copyright (C) 2021, Alliander (http://www.alliander.com)
# SPDX-License-Identifier: Apache-2.0

# We have a conf and classes directory, add to BBPATH
BBPATH .= ":${LAYERDIR}"

# We have recipes-* directories, add to BBFILES
BBFILES += "${LAYERDIR}/recipes-*/*/*.bb \
	${LAYERDIR}/recipes-*/*/*.bbappend"

BBFILE_COLLECTIONS += "meta-seapath-tools"
BBFILE_PATTERN_meta-seapath-tools= "^${LAYERDIR}/"
BBFILE_PRIORITY_meta-seapath-tools = "10"

LAYERSERIES_COMPAT_meta-seapath-tools = "zeus"

LAYERDEPENDS_meta-seapath-tools = "core openembedded-layer"
```
